## drivers/input/fingerprint/Kconfig
```kconfig
menu "Fingerprint Drivers"

config FINGERPRINT_FPC1020
	tristate "FingerPrint Cards fingerprint drvier support"
	help
	  say y here to enable fpc fingerprint driver support!

endmenu
```
